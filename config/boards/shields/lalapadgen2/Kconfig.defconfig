## config/boards/shields/lalapadgen2/Kconfig.defconfig
```kconfig
# 単体構成：右が親機（ペアリング先）
if SHIELD_LALAPADGEN2_RIGHT && !SHIELD_LALAPADGEN2_PERIPHERAL

config ZMK_KEYBOARD_NAME
    default "LalapadGen2"

config ZMK_SPLIT_ROLE_CENTRAL
    default y

config ZMK_SPLIT_BLE_CENTRAL_PERIPHERALS
    default 1
    
config BT_MAX_CONN
    default 5

endif

# ドングル構成：ドングルが親機、左右とも子機
if SHIELD_LALAPADGEN2_DONGLE

config ZMK_KEYBOARD_NAME
    default "LalapadGen2"

config ZMK_SPLIT_ROLE_CENTRAL
    default y

config ZMK_SPLIT_BLE_CENTRAL_PERIPHERALS
    default 2

# 左右2台＋Bluetooth の接続先5つ
config BT_MAX_CONN
    default 7

endif

if SHIELD_LALAPADGEN2_LEFT || SHIELD_LALAPADGEN2_RIGHT || SHIELD_LALAPADGEN2_DONGLE

config ZMK_SPLIT
    default y

endif
```

## config/boards/shields/lalapadgen2/Kconfig.shield
```kconfig
config SHIELD_LALAPADGEN2_LEFT
    def_bool $(shields_list_contains,lalapadgen2_left)

config SHIELD_LALAPADGEN2_RIGHT
    def_bool $(shields_list_contains,lalapadgen2_right)

config SHIELD_LALAPADGEN2_DONGLE
    def_bool $(shields_list_contains,lalapadgen2_dongle)

# 右手側をドングル構成の子機にする上乗せ
config SHIELD_LALAPADGEN2_PERIPHERAL
    def_bool $(shields_list_contains,lalapadgen2_peripheral)
```
